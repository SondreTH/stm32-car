/* =====================================================================
 * car_oled.c - I2C OLED: SSD1306 (0.96" / 0.91") or SH1106 (1.3")
 *
 * The display RAM is split into pages of 8 pixel rows. One byte is one
 * column of a page, bit 0 at the top. The framebuffer uses the same
 * layout, so oled_update() copies it out page by page. Page addressing
 * works the same on both controllers; SH1106 only needs a column offset.
 *
 * Every I2C write starts with a control byte: 0x00 = commands follow,
 * 0x40 = pixel data follows. HAL_I2C_Mem_Write() sends it as the
 * "memory address".
 * ===================================================================== */
#include "main.h"
#include "car_oled.h"
#include "car_config.h"
#include <string.h>

extern I2C_HandleTypeDef hi2c1;   /* PB8 SCL, PB9 SDA */

#define OLED_PAGES  (OLED_HEIGHT / 8)
#define I2C_TIMEOUT 10            /* ms per transfer; a 128-byte page takes ~3 ms at 400 kHz */

static uint8_t fb[OLED_PAGES][OLED_WIDTH];
static uint8_t addr = 0;          /* 7-bit I2C address, 0 = no display */

static bool send(uint8_t control, const uint8_t *d, uint16_t n) {
  return HAL_I2C_Mem_Write(&hi2c1, (uint16_t)(addr << 1), control, I2C_MEMADD_SIZE_8BIT,
                           (uint8_t *)d, n, I2C_TIMEOUT) == HAL_OK;
}

/* ------------------------------------------------------------------ init */
static const uint8_t initCmds[] = {
  0xAE,                                   /* display off while setting up       */
  0xD5, 0x80,                             /* clock divider / oscillator         */
  0xA8, OLED_HEIGHT - 1,                  /* multiplex: number of rows - 1      */
  0xD3, 0x00,                             /* no vertical offset                 */
  0x40,                                   /* start at RAM row 0                 */
  0x8D, 0x14,                             /* SSD1306 charge pump on (SH1106: no-op) */
  0x20, 0x02,                             /* page addressing mode               */
  OLED_FLIP ? 0xA0 : 0xA1,                /* column order                       */
  OLED_FLIP ? 0xC0 : 0xC8,                /* row order                          */
  0xDA, OLED_HEIGHT == 64 ? 0x12 : 0x02,  /* COM pin layout of the panel        */
  0x81, 0xCF,                             /* contrast 0..255                    */
  0xD9, 0xF1,                             /* pre-charge period                  */
  0xDB, 0x40,                             /* VCOMH level                        */
  0xA4,                                   /* show RAM contents                  */
  0xA6,                                   /* normal, not inverted               */
};

uint8_t oled_init(void) {
  addr = 0;
  for (uint8_t a = 0x3C; a <= 0x3D && !addr; a++)
    if (HAL_I2C_IsDeviceReady(&hi2c1, (uint16_t)(a << 1), 2, I2C_TIMEOUT) == HAL_OK) addr = a;
  if (!addr) return 0;

  static const uint8_t displayOn = 0xAF;
  if (!send(0x00, initCmds, sizeof initCmds)) { addr = 0; return 0; }
  oled_clear();
  if (!oled_update()) return 0;            /* clear the RAM before switching on */
  if (!send(0x00, &displayOn, 1)) { addr = 0; return 0; }
  return addr;
}

bool oled_update(void) {
  if (!addr) return false;
  for (uint8_t p = 0; p < OLED_PAGES; p++) {
    const uint8_t at[3] = { (uint8_t)(0xB0 | p),                       /* page p           */
                            (uint8_t)(0x00 | (OLED_COL_OFFSET & 0x0F)), /* column, low bits */
                            (uint8_t)(0x10 | (OLED_COL_OFFSET >> 4)) }; /* column, high bits */
    if (!send(0x00, at, 3) || !send(0x40, fb[p], OLED_WIDTH)) {
      addr = 0;                            /* lost it: stop until oled_init() again */
      return false;
    }
  }
  return true;
}

/* --------------------------------------------------------------- drawing */
void oled_clear(void) { memset(fb, 0, sizeof fb); }

void oled_pixel(int x, int y, bool on) {
  if (x < 0 || x >= OLED_WIDTH || y < 0 || y >= OLED_HEIGHT) return;
  uint8_t bit = (uint8_t)(1u << (y & 7));
  if (on) fb[y >> 3][x] |= bit; else fb[y >> 3][x] &= (uint8_t)~bit;
}

void oled_fill(int x, int y, int w, int h, bool on) {
  for (int j = y; j < y + h; j++)
    for (int i = x; i < x + w; i++) oled_pixel(i, j, on);
}

void oled_frame(int x, int y, int w, int h) {
  oled_fill(x, y, w, 1, true);  oled_fill(x, y + h - 1, w, 1, true);
  oled_fill(x, y, 1, h, true);  oled_fill(x + w - 1, y, 1, h, true);
}

/* ------------------------------------------------------------------ text */
/* 5x7 font, ASCII 32..126. One byte per column, bit 0 = top row, bit 6 = baseline.
 * g j p q y hang below it into bit 7, the row that is otherwise the line gap. */
static const uint8_t font[][5] = {
  {0x00,0x00,0x00,0x00,0x00}, {0x00,0x00,0x5F,0x00,0x00}, {0x00,0x07,0x00,0x07,0x00}, /*   ! " */
  {0x14,0x7F,0x14,0x7F,0x14}, {0x24,0x2A,0x7F,0x2A,0x12}, {0x23,0x13,0x08,0x64,0x62}, /* # $ % */
  {0x36,0x49,0x55,0x22,0x50}, {0x00,0x05,0x03,0x00,0x00}, {0x00,0x1C,0x22,0x41,0x00}, /* & ' ( */
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  {0x00,0x41,0x36,0x08,0x00}, {0x08,0x04,0x08,0x10,0x08},                             /* } ~   */
};

int oled_text(int x, int y, const char *s, int scale) {
  if (scale < 1) scale = 1;
  for (; *s; s++) {
    unsigned char c = (unsigned char)*s;
    const uint8_t *g = font[(c >= ' ' && c <= '~') ? c - ' ' : '?' - ' '];
    for (int col = 0; col < 6; col++) {
      uint8_t bits = (col < 5) ? g[col] : 0;   /* 6th column = gap between letters */
      for (int row = 0; row < 8; row++)
        oled_fill(x + col * scale, y + row * scale, scale, scale, (bits >> row) & 1);
    }
    x += 6 * scale;
  }
  return x;
}

/* integer without printf (same reason as lb_int in car_comms.c) */
int oled_int(int x, int y, int32_t v, int scale) {
  char t[12];
  int n = sizeof t - 1;
  t[n] = 0;
  uint32_t u = (v < 0) ? (uint32_t)(-(int64_t)v) : (uint32_t)v;
  do { t[--n] = (char)('0' + u % 10); u /= 10; } while (u);
  if (v < 0) t[--n] = '-';
  return oled_text(x, y, &t[n], scale);
}
